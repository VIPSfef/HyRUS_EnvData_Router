## src/px4/shtc3/Kconfig
```kconfig
menuconfig DRIVERS_HYGROMETER_SHTC3
	bool "SHTC3 temperature and humidity sensor"
	default n
	---help---
		Enable Sensirion SHTC3 on I2C address 0x70.
```

## src/px4/shtc3_probe/Kconfig
```kconfig
menuconfig SYSTEMCMDS_SHTC3_PROBE
    bool "shtc3_probe"
    default n
    ---help---
        One-shot SHTC3 product-ID diagnostic at address 0x70.
        No scan, reset, measurements, parameters or topic publication.
        Requires the SHTC3Protocol.hpp header from the SHTC3 overlay.
```
